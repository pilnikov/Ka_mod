## main/Kconfig.projbuild
```kconfig
menu "Web Radio"

	menu "Wifi Configuration"

		config WIFI_SSID
			string "WiFi SSID"
			default "myssid"
			help
				SSID (network name) to connect to.

		config WIFI_PASSWORD
			string "WiFi Password"
			default "mypass"
			help
				WiFi password (WPA or WPA2) to use.

				Can be left blank if the network has no security set.

	endmenu

	menu "Audio Output"

		choice
			prompt "Select Audio Output Mode"
			default AUDIO_OUTPUT_MODE_I2S
			help
				This option selects the audio output.

			config AUDIO_OUTPUT_MODE_I2S
				bool "Generic I2S"
			config AUDIO_OUTPUT_MODE_I2S_MERUS
				bool "Merus Audio I2S"
			config AUDIO_OUTPUT_MODE_DAC_BUILT_IN
				bool "Built-In DAC"
			config AUDIO_OUTPUT_MODE_PDM
				bool "PDM"
			config AUDIO_OUTPUT_MODE_VS1053
				bool "VS1053"
			config AUDIO_OUTPUT_MODE_A1S
				bool "A1S"
		endchoice

		config AUDIO_OUTPUT_MODE
			int
			default 0 if AUDIO_OUTPUT_MODE_I2S
			default 1 if AUDIO_OUTPUT_MODE_I2S_MERUS
			default 2 if AUDIO_OUTPUT_MODE_DAC_BUILT_IN
			default 3 if AUDIO_OUTPUT_MODE_PDM
			default 4 if AUDIO_OUTPUT_MODE_VS1053
			default 5 if AUDIO_OUTPUT_MODE_A1S

	endmenu

endmenu
```
